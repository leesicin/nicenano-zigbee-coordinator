## CMakeLists.txt
```
cmake_minimum_required(VERSION 3.20.0)
find_package(Zephyr REQUIRED HINTS $ENV{ZEPHYR_BASE})
project(zb_coordinator)
```

## prj.conf
```kconfig
CONFIG_ZIGBEE=y
CONFIG_ZIGBEE_ROLE_COORDINATOR=y
CONFIG_ZBOSS_TRACE_LOG_LEVEL_INF=y

CONFIG_LOG=y
CONFIG_SERIAL=y
CONFIG_USB_DEVICE_STACK=y
CONFIG_USB_CDC_ACM=y
```

## src/main.c
```c
#include <zephyr/kernel.h>
#include <zephyr/logging/log.h>
LOG_MODULE_REGISTER(main);

void main(void) {
    LOG_INF("Zigbee coordinator stub build OK");
    while (1) {
        k_sleep(K_MSEC(1000));
    }
}
```
